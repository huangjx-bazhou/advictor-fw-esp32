## main/Kconfig.projbuild
```kconfig
menu "AP Configuration"
    config AP_SSID
        string "AP SSID"
        default "TEST_TP-LINK"
        help
            SSID (network name) for the application to connect to.

    config AP_PASSWORD
        string "AP Password"
        default "12345678"
        help
            AP password (WPA or WPA2) for the application to use.
endmenu
```
